## meta-freebsd/conf/distro/freebsd.conf
```bitbake
#@TYPE: Distribution
#@NAME: FreeBSD
#@DESCRIPTION: Build a FreeBSD kernel and FreeBSD userspace with BitBake.

DISTRO = "freebsd"
DISTRO_NAME = "FreeBSD"
DISTRO_VERSION ?= "14"
FREEBSD_ABI_VERSION ?= "${DISTRO_VERSION}"
TARGET_OS = "freebsd${FREEBSD_ABI_VERSION}"
INIT_MANAGER = "freebsd"

# Keep Linux and FreeBSD builds in separate output trees when a developer uses
# the same checkout and switches DISTRO/MACHINE.
TMPDIR ?= "${TOPDIR}/tmp-${DISTRO}-${MACHINE}"

DISTRO_FEATURES = "ipv4 ipv6 largefile"
MACHINE_FEATURES_OPTED_OUT += "rtc"

PREFERRED_PROVIDER_virtual/kernel ?= "freebsd-kernel"

HOSTTOOLS += " \
    basename bmake bunzip2 bzip2 c++ cc chmod chown cmp comm cp date dd \
    dirname echo env expr false find flex fmt gunzip gzip head hostname id ln \
    ls m4 mkdir mktemp mv nice patch realpath rm sh sleep stat tee time touch \
    tr true uname uniq unxz wc which xz yacc \
"
HOSTTOOLS_NONFATAL += "etdump makefs mkimg"

# OE-Core's cross-canadian class rewrites Linux target OS variants by default
# and fatals on target tuples it does not know. FreeBSD keeps a versioned
# FreeBSD TARGET_OS instead.
MODIFYTOS:freebsd:class-cross-canadian = "0"

# Go/Rust cross-canadian SDK packagegroups currently assume Linux targets.
SDK_TOOLCHAIN_LANGS:remove:freebsd = "go rust"

# These image recipes deploy whole FreeBSD artifacts directly instead of using
# OE package managers to compose the root filesystem.
IMAGE_CLASSES:remove = "image_types"
```

## meta-freebsd/conf/distro/include/init-manager-freebsd.inc
```bitbake
# FreeBSD images bring their own init, service management, and /dev handling
# from the FreeBSD base system instead of OE's Linux init-manager stacks.
VIRTUAL-RUNTIME_dev_manager = ""
VIRTUAL-RUNTIME_init_manager = ""
VIRTUAL-RUNTIME_initscripts = ""
VIRTUAL-RUNTIME_login_manager = ""
```

## meta-freebsd/conf/layer.conf
```bitbake
# We have a conf and classes directory, add to BBPATH.
BBPATH .= ":${LAYERDIR}"

# We have recipes-* directories, add to BBFILES.
BBFILES += "${LAYERDIR}/recipes-*/*/*.bb"

BBFILE_COLLECTIONS += "freebsd"
BBFILE_PATTERN_freebsd = "^${LAYERDIR}/"
BBFILE_PRIORITY_freebsd = "6"

LAYERSERIES_COMPAT_freebsd = "blacksail"
LAYERVERSION_freebsd = "1"

BBLAYERS_LAYERINDEX_NAME_freebsd = "meta-freebsd"

FREEBSD_LAYERDIR = "${LAYERDIR}"
```

## meta-freebsd/conf/machine/freebsd-amd64.conf
```bitbake
#@TYPE: Machine
#@NAME: FreeBSD amd64
#@DESCRIPTION: FreeBSD/amd64 target built from the local freebsd-src tree.

DEFAULTTUNE ?= "core2-64"
require conf/machine/include/x86/tune-core2.inc

FREEBSD_TARGET ?= "amd64"
FREEBSD_TARGET_ARCH ?= "amd64"
FREEBSD_KERNEL_CONFIG ?= "GENERIC"

KERNEL_IMAGETYPE = "kernel"
MACHINE_FEATURES += "efi pci"

# Optional QEMU hints for developers who want to boot the deployed raw image.
QB_SYSTEM_NAME = "qemu-system-x86_64"
QB_MACHINE = "-machine q35"
QB_CPU = "-cpu qemu64"
QB_SMP ?= "-smp 4"
QB_MEM ?= "-m 1024"
QB_SERIAL_OPT = "-serial mon:stdio"
QB_ROOTFS_OPT = "-drive file=@ROOTFS@,format=raw,if=virtio"
```

## meta-freebsd/conf/machine/freebsd-arm64.conf
```bitbake
#@TYPE: Machine
#@NAME: FreeBSD arm64
#@DESCRIPTION: FreeBSD/arm64 target built from the local freebsd-src tree.

require conf/machine/include/arm/armv8a/tune-cortexa57.inc

FREEBSD_TARGET ?= "arm64"
FREEBSD_TARGET_ARCH ?= "aarch64"
FREEBSD_KERNEL_CONFIG ?= "GENERIC"

KERNEL_IMAGETYPE = "kernel"
MACHINE_FEATURES += "efi"

# Optional QEMU hints for developers who want to boot the deployed raw image.
QB_SYSTEM_NAME = "qemu-system-aarch64"
QB_MACHINE = "-machine virt"
QB_CPU = "-cpu cortex-a57"
QB_SMP ?= "-smp 4"
QB_MEM ?= "-m 1024"
QB_SERIAL_OPT = "-serial mon:stdio"
QB_ROOTFS_OPT = "-drive file=@ROOTFS@,format=raw,if=virtio"
```

## meta-ypbsd/conf/layer.conf
```bitbake
# We have a conf and classes directory, add to BBPATH.
BBPATH .= ":${LAYERDIR}"

# We have recipes-* directories, add to BBFILES.
BBFILES += " \
    ${LAYERDIR}/recipes-*/*/*.bb \
    ${LAYERDIR}/recipes-*/*/*.bbappend \
"

BBFILE_COLLECTIONS += "ypbsd"
BBFILE_PATTERN_ypbsd = "^${LAYERDIR}/"
BBFILE_PRIORITY_ypbsd = "6"

LAYERSERIES_COMPAT_ypbsd = "blacksail"
LAYERVERSION_ypbsd = "1"
```
